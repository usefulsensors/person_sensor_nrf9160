&i2c2 {
    compatible = "nordic,nrf-twim";
	status = "okay";
	sda-pin = < 30 >;
	scl-pin = < 31 >;
    clock-frequency = <I2C_BITRATE_STANDARD>;  
	
	/* The I2C address could be one of two, here 0x76 is assumed */
	sens@62 {
		compatible = "nordic,nrf-twim";
		reg = <0x62;
		label = "SENS21231";
	};
};

&uart1 {
    status = "disabled";
};